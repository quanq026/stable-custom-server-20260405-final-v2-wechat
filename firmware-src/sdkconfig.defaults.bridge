## firmware-src/sdkconfig.defaults.bridge
```kconfig
CONFIG_BOARD_TYPE_ES3N28P_LCD28=y
CONFIG_LCD_ILI9341_240X320=y
CONFIG_CODEC_ES8311_SUPPORT=y
CONFIG_LANGUAGE_VI_VN=y
CONFIG_BRIDGE_MODE_ENABLE=y
# CONFIG_BRIDGE_DISCOVERY_ENABLE is not set
CONFIG_BRIDGE_WEBSOCKET_PORT=8000
CONFIG_BRIDGE_WEBSOCKET_PATH="/xiaozhi/v1/"
CONFIG_BRIDGE_WEBSOCKET_URL=""
```

## firmware-src/sdkconfig.defaults.bridge.touch
```kconfig
# CONFIG_BRIDGE_DISCOVERY_ENABLE is not set
CONFIG_BRIDGE_TOUCH_INPUT_ENABLE=y
CONFIG_BRIDGE_WEBSOCKET_PORT=8000
CONFIG_BRIDGE_WEBSOCKET_PATH="/xiaozhi/v1/"
CONFIG_USE_WECHAT_MESSAGE_STYLE=y
```

## firmware-src/sdkconfig.defaults.lan
```kconfig
CONFIG_BOARD_TYPE_ES3N28P_LCD28=y
CONFIG_LCD_ILI9341_240X320=y
CONFIG_CODEC_ES8311_SUPPORT=y
CONFIG_OTA_URL="http://192.168.1.15:8003/xiaozhi/ota/"
```
